## meta-photon/conf/layer.conf
```bitbake
BBPATH .= ":${LAYERDIR}"
BBFILES += "${LAYERDIR}/recipes-*/*/*.bb \
             ${LAYERDIR}/recipes-*/*/*.bbappend"

BBFILE_COLLECTIONS += "meta-photon"
BBFILE_PATTERN_meta-photon = "^${LAYERDIR}/"
BBFILE_PRIORITY_meta-photon = "10"

LAYERDEPENDS_meta-photon = "core raspberrypi openembedded-layer"
LAYERSERIES_COMPAT_meta-photon = "scarthgap"
```
